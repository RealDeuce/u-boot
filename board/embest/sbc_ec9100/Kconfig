## board/embest/sbc_ec9100/Kconfig
```kconfig
if TARGET_SBC_EC9100

config SYS_BOARD
	default "sbc_ec9100"

config SYS_VENDOR
	default "embest"

config SYS_CONFIG_NAME
	default "sbc_ec9100"

config SYS_CPU
	default "armv7"

config SYS_SOC
	default "mx6"

config EC9100_BOOT_FROM_EMMC
	depends on TARGET_SBC_EC9100
	bool "Boot from eMMC"
	help
		Select to boot from the on-board eMMC.  If this
		is n, boots from the SD card.

endif
```

## configs/sbc_ec9100_defconfig
```kconfig
CONFIG_ARM=y
CONFIG_MX6UL=y
CONFIG_ARCH_MX6=y
CONFIG_TARGET_SBC_EC9100=y
CONFIG_TEXT_BASE=0x87800000
CONFIG_BOARD_EARLY_INIT_F=y
CONFIG_NR_DRAM_BANKS=1
CONFIG_MXC_UART=y
CONFIG_FSL_USDHC=y
CONFIG_FSL_QSPI=y
CONFIG_MMC=y
CONFIG_HUSH_PARSER=y
CONFIG_CMD_MMC=y
CONFIG_CMD_FAT=y
CONFIG_CMD_EXT2=y
CONFIG_CMD_EXT4=y
CONFIG_CMD_FS_GENERIC=y
CONFIG_DOS_PARTITION=y
CONFIG_IMX_CONFIG="board/embest/sbc_ec9100/imximage.cfg"
CONFIG_CMD_MEMTEST=y
CONFIG_SYS_MEMTEST_START=0x80000000
CONFIG_SYS_MEMTEST_END=0x90000000
CONFIG_SUPPORT_EMMC_BOOT=y
CONFIG_EC9100_BOOT_FROM_EMMC=y
CONFIG_DEFAULT_DEVICE_TREE="sbc_ec9100"
CONFIG_OF_CONTROL=y
CONFIG_DM_GPIO=y
CONFIG_CMD_BOOTZ=y
CONFIG_BOOTCOMMAND="run loadfdt; bootflow scan -lb; run mmcboot"
CONFIG_BOOTSTD_FULL=y
CONFIG_USE_BOOTCOMMAND=y
CONFIG_DEFAULT_FDT_FILE="sbc_ec9100.dtb"

#CONFIG_PHY_MICREL_KSZ8XXX=y
#CONFIG_PHY_MICREL=y
#CONFIG_FEC_MXC=y
#CONFIG_PINCTRL=y
#CONFIG_PINCTRL_FULL=y
#CONFIG_PINCTRL_GENERIC=y
#CONFIG_PINMUX=y
#CONFIG_PINCTRL_IMX6=y
#CONFIG_DM_THERMAL=y
#CONFIG_IMX_THERMAL=y
#CONFIG_USB=y
#CONFIG_MII=y
#CONFIG_RMII=y
#CONFIG_NET_RANDOM_ETHADDR=y
#CONFIG_CMD_DHCP=y
#CONFIG_CMD_WGET=y
#CONFIG_CMD_MII=y
#CONFIG_CMD_MDIO=y
#CONFIG_CMD_PING=y
#CONFIG_CMD_DNS=y
#CONFIG_CMD_LINK_LOCAL=y
#CONFIG_CMD_PXE=y
#CONFIG_IPV6=y
#CONFIG_DM_ETH_PHY=y
#CONFIG_PHYLIB=y
#CONFIG_POWER=y
#CONFIG_DM_PMIC=y
#CONFIG_PMIC_CHILDREN=y
#CONFIG_DM_PMIC_PFUZE100=y
#CONFIG_DM_I2C=y
# Note: Only one of these will actually be needed...
#CONFIG_SYS_I2C_MXC=y
#CONFIG_SYS_I2C_IMX_LPI2C=y
```
